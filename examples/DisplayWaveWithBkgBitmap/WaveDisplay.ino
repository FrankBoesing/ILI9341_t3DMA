#include "SPI.h"
#include <ILI9341_t3DMA.h>

#define TFT_DC      15
#define TFT_CS      10
#define TFT_RST     4  // 255 = unused, connect to 3.3V
#define TFT_MOSI    11
#define TFT_SCLK    13
#define TFT_MISO    12

ILI9341_t3DMA tft = ILI9341_t3DMA(TFT_CS, TFT_DC, TFT_RST, TFT_MOSI, TFT_SCLK, TFT_MISO);

unsigned char vu_img_sm1_bmp[] = {
  0x42, 0x4d, 0x8a, 0x10, 0x00, 0x00, 0x00, 0x00, 0x00, 0x00, 0x8a, 0x00,
  0x00, 0x00, 0x7c, 0x00, 0x00, 0x00, 0x40, 0x00, 0x00, 0x00, 0x20, 0x00,
  0x00, 0x00, 0x01, 0x00, 0x10, 0x00, 0x03, 0x00, 0x00, 0x00, 0x00, 0x10,
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  0x41, 0x41, 0x21, 0x39, 0x01, 0x31, 0xe1, 0x30, 0xc1, 0x28
};
unsigned int vu_img_sm1_bmp_len = 4234;

void setup() {
  tft.begin();

  //START DMA MODE
  tft.refresh();
    
  tft.dfillScreen(ILI9341_BLACK);
  tft.setTextColor(ILI9341_YELLOW);
  tft.setTextSize(2);
  tft.println("Hello...");
  
}
int t = 0;

void loop() {

  // calculate sine wave
  short signed int v[320];
  for (int i=1; i<320; i++){
    v[i] = (int8_t)(sin((i+t)/20.0) * 100.0);
  }
  
  //tft.stopRefresh();
  uint16_t *p = (uint16_t*)vu_img_sm1_bmp + 69;
  tft.dwriteRectScale(0,0, 64, 32, 240, 320, p);

  for (int i=1; i<320; i++){
    drawLine(120 + v[i-1], i-1, 120 + v[i], i, ILI9341_BLACK);
  }
  //tft.refresh();
  t++;
}

void drawLine( uint16_t x0, uint16_t y0, uint16_t x1, uint16_t y1, uint16_t color)
{
    int x = x1-x0;
    int y = y1-y0;
    int dx = abs(x), sx = x0<x1 ? 1 : -1;
    int dy = -abs(y), sy = y0<y1 ? 1 : -1;
    int err = dx+dy, e2;                                                /* error value e_xy             */
    for (;;){                                                           /* loop                         */
        tft.ddrawPixel(x0,y0,color);
        e2 = 2*err;
        if (e2 >= dy) {                                                 /* e_xy+e_x > 0                 */
            if (x0 == x1) break;
            err += dy; x0 += sx;
        }
        if (e2 <= dx) {                                                 /* e_xy+e_y < 0                 */
            if (y0 == y1) break;
            err += dx; y0 += sy;
        }
    }
}
